## configs/sheng_macos_defconfig
```kconfig
CONFIG_XNU_BUILD_ARCHIVES=y
CONFIG_XNU_DT_PANIC_REGION=y
CONFIG_XNU_ARMVIRT_PLATFORM=n
CONFIG_XNU_EXTRA_LD_ARCHIVES="-Wl,-force_load,{tree}/build/sheng-source-storage/libShengSourceStorage.a"
CONFIG_XNU_KERNEL_CHAINED_FIXUPS=y
# The boot image carries the signed policy headers; their hash tables are userdata objects.
# Owner-verified UFS windows from the source storage archive authorize the mounted root.
# SystemOS cryptex, boot manifest and the writable Data volume from the Data seed's RAM disk.
CONFIG_XNU_OWNER_DATA_VOLUME_UUID="79157BD4-6A8C-45D6-A0EB-11FEA89BDE46"
# CONFIG_XNU_SOURCE_STORAGE is not set
# CONFIG_XNU_SOURCE_STORAGE_TABLES is not set
# CONFIG_XNU_OWNER_ROOT_AUDIT is not set
# CONFIG_XNU_OWNER_ROOT_TRUST is not set
# CONFIG_XNU_OWNER_CACHE_MOUNT is not set
# CONFIG_XNU_OWNER_CACHE_STARTUP is not set
# CONFIG_XNU_OWNER_BOOT_MANIFEST is not set
# CONFIG_XNU_OWNER_DATA_MOUNT is not set
# CONFIG_XNU_OWNER_UNION_SYSTEMOS is not set
# CONFIG_XNU_SOURCE_STORAGE is not set
# CONFIG_XNU_SOURCE_STORAGE_TABLES is not set
# CONFIG_XNU_OWNER_ROOT_AUDIT is not set
# CONFIG_XNU_OWNER_ROOT_TRUST is not set
# CONFIG_XNU_OWNER_CACHE_MOUNT is not set
# CONFIG_XNU_OWNER_CACHE_STARTUP is not set
# CONFIG_XNU_OWNER_BOOT_MANIFEST is not set
# CONFIG_XNU_OWNER_DATA_MOUNT is not set
# CONFIG_XNU_OWNER_UNION_SYSTEMOS is not set
# CONFIG_XNU_NATIVE_RAM_BLOCK is not set
# CONFIG_XNU_NATIVE_VIRTIO_BLOCK is not set
# CONFIG_XNU_VERIFIED_ROOT_PROBE is not set
# CONFIG_XNU_NATIVE_AES is not set
# CONFIG_XNU_NATIVE_LEGACY_DISPLAY is not set
# CONFIG_XNU_NATIVE_ADRENO is not set
# CONFIG_XNU_SHENG_PMGR is not set
# CONFIG_XNU_NATIVE_ARCH_TIMER is not set
# CONFIG_XNU_ARMCPU is not set
# CONFIG_XNU_SOURCE_PTHREAD is not set
# CONFIG_XNU_SOURCE_CORECRYPTO14 is not set
# CONFIG_XNU_NATIVE_PAN is not set
CONFIG_XNU_SOURCE_CORECRYPTO14=y
CONFIG_XNU_CRYPTO_BOOTSTRAP="source"
```
